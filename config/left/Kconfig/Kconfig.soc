## temp/left/Kconfig/Kconfig.soc.arch
```kconfig
osource "/home/laujonat/hakkei/ryval-zmk/zephyr/soc/$(ARCH)/Kconfig"
osource "/home/laujonat/hakkei/ryval-zmk/zephyr/soc/$(ARCH)/*/Kconfig"
```

## temp/left/Kconfig/Kconfig.soc.defconfig
```kconfig
osource "/home/laujonat/hakkei/ryval-zmk/zephyr/soc/$(ARCH)/*/Kconfig.defconfig"
```
